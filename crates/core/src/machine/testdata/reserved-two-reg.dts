/dts-v1/;

/memreserve/ 0x0000000082000000 0x0000000000001000;

/ {
	#address-cells = <2>;
	#size-cells = <2>;

	reserved-memory {
		#address-cells = <2>;
		#size-cells = <2>;
		ranges;

		firmware@80000000 {
			no-map;
			reg = <0x0 0x80000000 0x0 0x1000 0x0 0x81000000 0x0 0x2000>;
		};
	};
};
