/dts-v1/;

/ {
	#address-cells = <0x02>;
	#size-cells = <0x02>;

	aliases {
		serial0 = "/pl011@9000000";
	};

	pl011@9000000 {
		compatible = "arm,pl011", "arm,primecell";
		reg = <0x00 0x9000000 0x00 0x1000>;
	};

	/* bus-range starts at 0x10: `reg` is that bus's config base (ROADMAP §11.5). */
	pcie@40000000 {
		compatible = "pci-host-ecam-generic";
		device_type = "pci";
		#address-cells = <0x03>;
		#size-cells = <0x02>;
		bus-range = <0x10 0x1f>;
		reg = <0x00 0x40000000 0x00 0x1000000>;
		linux,pci-domain = <0x00>;
		dma-coherent;
	};
};
