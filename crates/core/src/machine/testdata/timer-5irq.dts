/dts-v1/;

/ {
	#address-cells = <0x02>;
	#size-cells = <0x02>;

	pl011@9000000 {
		compatible = "arm,pl011", "arm,primecell";
		reg = <0x00 0x9000000 0x00 0x1000>;
	};

	timer {
		compatible = "arm,armv8-timer", "arm,armv7-timer";
		always-on;
		interrupts = <0x01 0x0d 0x04 0x01 0x0e 0x04 0x01 0x0b 0x04 0x01 0x0a 0x04 0x01 0x09 0x04>;
	};
};
